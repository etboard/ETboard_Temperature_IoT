/******************************************************************************************
 * FileName     : Temperature_IoT.ino
 * Description  : 이티보드로 온도를 측정하여 스마트폰으로 확인
 * Author       : SCS
 * Created Date : 2022.08.10
 * Reference    : 
 * Modified     : 
 * Modified     : 
******************************************************************************************/
const char* board_hardware_verion = "ETBoard_V1.1";
const char* board_firmware_verion = "tmp_iot_0.91";

//================================================-=========================================
// 응용 프로그램 구성 사용하기                       
//==========================================================================================
#include "app_config.h"
APP_CONFIG app;


//==========================================================================================
// DHT11 센서 사용하
//==========================================================================================
#include "DHT.h"                                  // 디지털 온습도 센서
DHT dht(D9, DHT11);                               // DHT11


//==========================================================================================
// 상수 정의                                       
//==========================================================================================
// 메시지 송신 주기 : 주의!!!! 너무 빨리 또는 많이 보내면 서버에서 거부할 수 있음(Banned)
//------------------------------------------------------------------------------------------
#define NORMAL_SEND_INTERVAL  (1000 * 5)          // 권장 5초 (단위: 초/1000)


//==========================================================================================
// 전역 변수 선언                                   
//==========================================================================================
float humidity;                                   // 습도
float temperature;                                // 온도


//==========================================================================================
void setup()                                      // 설정 함수 
//==========================================================================================
// (권장 사항) 이 함수에서는 코딩하지 마십시오. custom_setup()에 코딩하십시오.
//------------------------------------------------------------------------------------------
{
  app.setup();                                    // 응용 프로그램 기본 설정

  custom_setup();                                 // 사용자 맞춤형 설정
}


//==========================================================================================
void custom_setup()                               // 사용자 맞춤형 설정 함수
//==========================================================================================
{
  //----------------------------------------------------------------------------------------
  // 여기에 사용자 맞춤형 설정을 코딩하세요.
  //----------------------------------------------------------------------------------------
}


//==========================================================================================
void loop()                                       // 반복 루틴
//==========================================================================================
//  (권장 사항) 이 함수를 가능하면 수정하지 마십시오 !!! 
//  do_sensing_process()와 send_sensor_value()를 수정하십시오.
//------------------------------------------------------------------------------------------
{
  //----------------------------------------------------------------------------------------
  // MQTT 백그라운드 동작 
  //----------------------------------------------------------------------------------------
  app.mqtt.loop();

  //----------------------------------------------------------------------------------------
  // 센싱 처리
  //----------------------------------------------------------------------------------------       
  do_sensing_process();    
    
  //----------------------------------------------------------------------------------------
  // 주기적으로 메시지 전송 처리
  //----------------------------------------------------------------------------------------
  if (millis() - app.lastMillis > NORMAL_SEND_INTERVAL) {  
    send_sensor_value();                          // 센서 값 송신
    app.lastMillis = millis();                    // 현재 시각 업데이트
  }  

  //----------------------------------------------------------------------------------------
  // 동작 상태 LED 깜밖이기
  //----------------------------------------------------------------------------------------  
  app.etboard.normal_blink_led();               
}


//==========================================================================================
void do_sensing_process()                       // 자동화 처리 함수
//==========================================================================================
// 여기에 자동화 처리를 코딩하세요.
//------------------------------------------------------------------------------------------
{ 
  humidity = dht.readHumidity();                  // DHT 센서에서 습도 읽기
  if (isnan(humidity)) {                          // 오류가 발생하면
    humidity = -99;                               // 습도를 -99로 강제 설정
    Serial.println(F("Failed to read humidity from DHT sensor! Now sleep 1000"));
    delay(1000);                                  // 1초 대기
    return;
  }  
  
  temperature = dht.readTemperature();            // DHT 센서에서 온도 읽기           
  if (isnan(temperature)) {                       // 오류가 발생하면
    temperature = -99;                            // 온도를 -99로 강제 설정
    Serial.println(F("Failed to read temperature from DHT sensor! Now sleep 1000"));
    delay(1000);                                  // 1초 대기
    return;
  }  

  display_Information();                          // 센싱 정보를 OLED에 표시
}


//==========================================================================================
void display_Information()                        // 센싱 정보 OLED 표시 함수
//==========================================================================================
{
  String string_t;
  string_t= String(temperature, 2);               // 온도를 문자열로 변환
  
  app.oled.setLine(1, board_firmware_verion);     // 1번째 줄에 펌웨어 버전
  app.oled.setLine(2,"M:" + app.mqtt.mac_address.substring(9)); // 2번재 줄에 MAC 주소
  app.oled.setLine(3,"T:" + string_t);            // 3번재 줄에 온도
  app.oled.display();                             // OLED에 표시
}


//==========================================================================================
void send_sensor_value()
//==========================================================================================
{
  DynamicJsonDocument doc(1024);
  //doc["mac"] = app.mqtt.mac_address.substring(9);
  doc["temperature"] = app.etboard.round2(temperature);
  doc["humidity"] = humidity;

  String output;
  serializeJson(doc, output);
  app.mqtt.publish_tele("/sensor", output);       // 메시지 송신
}


//==========================================================================================
void onConnectionEstablished()                    // MQTT 연결되었을 때 동작하는 함수
//==========================================================================================
{
  app.mqtt.onConnectionEstablished();             // MQTT 연결되었을 때 동작  
}


//==========================================================================================
//                                                    
// (주)한국공학기술연구원 http://et.ketri.re.kr       
//                                                    
//==========================================================================================
